// SPDX-License-Identifier: GPL-2.0-or-later OR MIT
/dts-v1/;

#include "qca953x_tplink_tl-wr810n.dtsi"

/ {
	compatible = "tplink,tl-wr810n-v1", "qca,qca9531";
	model = "TP-Link TL-WR810N v1";

	};

